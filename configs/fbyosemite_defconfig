## configs/fbyosemite_defconfig
```kconfig
CONFIG_ARM=y
CONFIG_ASPEED=y
CONFIG_TARGET_AST2400=y
CONFIG_SYS_CONFIG_NAME="fbyosemite"
CONFIG_SYS_PROMPT="FB-Yosemite> "
```

## configs/wedge100_defconfig
```kconfig
CONFIG_ARM=y
CONFIG_ASPEED=y
CONFIG_TARGET_AST2400=y
CONFIG_SYS_CONFIG_NAME="wedge100"
CONFIG_SYS_PROMPT="Wedge100> "
```

## configs/wedge_defconfig
```kconfig
CONFIG_ARM=y
CONFIG_ASPEED=y
CONFIG_SYS_CONFIG_NAME="wedge"
CONFIG_TARGET_AST2400=y
CONFIG_SYS_PROMPT="Wedge> "
```
